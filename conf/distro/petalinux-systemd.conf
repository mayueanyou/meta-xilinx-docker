## conf/distro/petalinux-systemd.conf
```bitbake
require conf/distro/petalinux.conf
 
DISTRO = "petalinux-systemd"
DISTRO_NAME = "PetaLinux with systemd"
 
INIT_MANAGER = "systemd"
 
IMAGE_INSTALL:append = " connman connman-client"
```

## conf/layer.conf
```bitbake
IMAGE_INSTALL:append = " docker docker-ce-contrib"
# Add extra space (in KB) for Docker images (10Gib)
IMAGE_ROOTFS_EXTRA_SPACE = "10485760"

# Remove wic because it causes circular dependencies with bundled initramfs
IMAGE_FSTYPES:remove = "wic.qemu-sd"
INITRAMFS_IMAGE = "petalinux-image-minimal"
INITRAMFS_IMAGE_BUNDLE = "1"
```
